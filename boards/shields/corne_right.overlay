/ {
    compatible = "zmk,keyboard";

    /* --- RGB underglow --- */
    ws2812: ws2812 {
        compatible = "worldsemi,ws2812";
        label = "WS2812";
        chain-length = <27>;              /* total de LEDs */
        spi-max-frequency = <4000000>;
        data-gpios = <&gpio0 15 GPIO_ACTIVE_HIGH>; /* pino do Corne right */
        color-order = "GRB";
        status = "okay";
    };

    zmk,underglow {
        compatible = "zmk,underglow";
        label = "ZMK Underglow";
        chain-length = <27>;
        color-order = "GRB";
        spi-max-frequency = <4000000>;
        data-gpios = <&gpio0 15 GPIO_ACTIVE_HIGH>;
        status = "okay";
    };
};
